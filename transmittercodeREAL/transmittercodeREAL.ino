#include <SoftwareSerial.h>
#include <string.h>
#include <stdint.h>


SoftwareSerial XBee(15, 14); // RX, TX

int wakePin = 16;    

byte frame1[] = {0x7E, 0x01, 0x0D, 0x10, 0x01, 0x00, 0x00, 0x00, 0x00, 0x00, 0x00, 0x00, 0x00, 0x00, 0x00, 0x00, 0x00, 0x01, 0x49, 0x01, 0x01, 0x01, 0x01, 0x01, 0x01,
0x01, 0x01, 0x01, 0x01, 0x01, 0x01, 0x01, 0x01, 0x01, 0x01, 0x01, 0x01, 0x01, 0x01, 0x01, 0x01, 0x01, 0x01, 0x01, 0x01, 0x01, 0x01, 0x01, 0x01, 0x01, 0x01, 0x01, 0x01, 
0x01, 0x01, 0x01, 0x01, 0x01, 0x01, 0x01, 0x01, 0x01, 0x01, 0x01, 0x01, 0x01, 0x01, 0x01, 0x01, 0x01, 0x01, 0x01, 0x01, 0x01, 0x01, 0x01, 0x01, 0x01, 0x01, 0x01, 0x01, 
0x01, 0x01, 0x01, 0x01, 0x01, 0x01, 0x01, 0x01, 0x01, 0x01, 0x01, 0x01, 0x01, 0x01, 0x01, 0x01, 0x01, 0x01, 0x01, 0x01, 0x01, 0x01, 0x01, 0x01, 0x01, 0x01, 0x01, 0x01, 
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0x01, 0x01, 0x01, 0x01, 0x01, 0x01, 0x01, 0x01, 0x01, 0x01, 0x01, 0x01, 0x01, 0x01, 0x01, 0x01, 0x01, 0x01, 0x01, 0x01, 0x01, 0x01, 0x01, 0xA7};
int x = 0;



void createFrame() {

  
    byte data[] = {0x48, 0x65, 0x6C, 0x6C, 0x6F}; // "Hello"
  byte destAddr[] = {0xFF, 0xFE}; // Destination address
  byte frameID = 0x01; // Frame ID

  // Calculate the length of the data
  int dataLength = sizeof(data);

  // Calculate the total length of the frame
  int frameLength = 17 + dataLength;

  // Create a buffer for the frame
  byte frame[frameLength];

  // sTART DELIMETER
 frame[0] = 0x7E;         // start delimiter
  frame[1] = 0x00;         // MSB of length
  frame[2] = frameLength -4; // LSB of length (subtract 4 for other fields)
  frame[3] = 0x10;         // API identifier (0x10 = transmit request)
  frame[4] = 0x01;         // frame ID (can be any value)
  frame[5] = 0x00;         // 64-bit address (not used in this example)
  frame[6] = 0x00;
  frame[7] = 0x00;
  frame[8] = 0x00;
  frame[9] = 0x00;
  frame[10] = 0x00;
  frame[11] = 0x00;        // 16-bit address (broadcast)
  frame[12] = 0x00;
  frame[13] = 0x00;        // 16-bit address (broadcast)
  frame[14] = 0x00;
  frame[15] = 0x00;        // Brodcast radius
  frame[16] = 0x00;

  // Copy the data to the frame
  for (int i = 0; i < dataLength; i++) {
    frame[16 + i] = data[i];
  }

  // Calculate the checksum
  byte checksum = 0;
  for (int i = 3; i < frameLength - 1; i++) {
    checksum += frame[i];
  }
  checksum = 0xFF - checksum;
  //Serial.println(checksum);

  // Add the checksum to the frame
  frame[frameLength - 1] = 0xFA;
  //memcpy(frame1, frame, sizeof(frame));
}

void setup() {
  Serial.begin(9600);
  XBee.begin(9600);
  pinMode(wakePin, OUTPUT);                       
  delay(500);
  Serial.println("Setup Complete");                 //debug
 
  //XBee.write(frame1, sizeof(frame1));   
}



void loop() 
{   
  if(XBee.available()){
    Serial.print("Xbee Available");
  }
  else{
    Serial.print("No Xbee Available");
  }
  x = x+1;
  
  String input = ("Hello," + String(x));
  byte data[input.length()];
  input.getBytes(data, input.length()+1);
  //   for (int i = 0; i < sizeof(data); i++) {
  //   Serial.println(data[i]);
  // }
  
  // byte data[] = {0x48, 0x65, 0x6C, 0x6C, 0x6F}; // "Hello"
  byte destAddr[] = {0xFF, 0xFE}; // Destination address
  byte frameID = 0x01; // Frame ID

  // Calculate the length of the dataS
  int dataLength = sizeof(data);

  // Calculate the total length of the frame
  int frameLength = 17 + dataLength + 1 ;

  // Create a buffer for the frame
  byte frame[frameLength];

  // sTART DELIMETER
 frame[0] = 0x7E;         // start delimiter
  frame[1] = 0x00;         // MSB of length
  frame[2] = frameLength -4; // LSB of length (subtract 4 for other fields)
  frame[3] = 0x10;         // API identifier (0x10 = transmit request)
  frame[4] = 0x01;         // frame ID (can be any value)
  frame[5] = 0x00;         // 64-bit address (not used in this example)
  frame[6] = 0x00;
  frame[7] = 0x00;
  frame[8] = 0x00;
  frame[9] = 0x00;
  frame[10] = 0x00;
  frame[11] = 0x00;        // 16-bit address (broadcast)
  frame[12] = 0x00;
  frame[13] = 0x00;        // 16-bit address (broadcast)
  frame[14] = 0x00;
  frame[15] = 0x00;        // Brodcast radius
  frame[16] = 0x00;

  // Copy the data to the frame
  for (int i = 0; i < dataLength; i++) {
    frame[17 + i] = data[i];
  }

  // Calculate the checksum
  byte checksum = 0;
  for (int i = 3; i < frameLength-1; i++) {
    checksum += frame[i];
  }
  checksum = 0xFF - checksum;
  //Serial.println(checksum);

  // Add the checksum to the frame
  frame[frameLength - 1] = checksum;
//  for (int i = 0; i < frameLength; i++) {
//    Serial.println(frame[i]);
//  }
  
    XBee.write(frame, sizeof(frame));   
  delay(1000);
    
  
}